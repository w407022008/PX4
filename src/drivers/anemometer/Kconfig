## src/drivers/anemometer/Kconfig
```kconfig
menu "Anemometer"
    menuconfig COMMON_ANEMOMETER
        bool "Common anemometer module's"
        default n
        select DRIVERS_ANEMOMETER_SFM3000
        ---help---
            Enable default set of anemometer drivers
    rsource "*/Kconfig"
endmenu #Anemometer
```

## src/drivers/anemometer/sfm3000/Kconfig
```kconfig
menuconfig DRIVERS_ANEMOMETER_SFM3000
	bool "sfm3000"
	default n
	---help---
		Enable support for sfm3000
```

## src/drivers/distance_sensor/tfmini_s/Kconfig
```kconfig
menuconfig DRIVERS_DISTANCE_SENSOR_TFMINI_S
	bool "tfmini_s"
	default n
	---help---
		Enable support for tfmini_s
```

## src/examples/anemometer_test/Kconfig
```kconfig
menuconfig EXAMPLES_ANEMOMETER_TEST
	bool "anemometer_test"
	default n
	---help---
		Enable support for anemometer_test
```

## src/examples/vision_test/Kconfig
```kconfig
menuconfig EXAMPLES_VISION_TEST
	bool "vision_test"
	default n
	---help---
		Enable support for vision_test
```
